#include <SPI.h>
#include <MFRC522.h>

#define RST_PIN    9   // 
#define SS_PIN    10    //

MFRC522 mfrc522(SS_PIN, RST_PIN); // Create MFRC522 instance
#include "NDEF.h"

#define PAYLOAD_SIZE 236
uint8_t payload[PAYLOAD_SIZE] = {};

void setup(void)
{
  Serial.begin(9600);
  pinMode(SS_PIN, OUTPUT);
  pinMode(RST_PIN, OUTPUT);
  while (!Serial);    // Do nothing if no serial port is opened (added for Arduinos based on ATMEGA32U4)
  SPI.begin();      // Init SPI bus
  mfrc522.PCD_Init();   // Init MFRC522
}

void loop(void)
{
  memset(payload, 0, PAYLOAD_SIZE);

  //memcpy(payload, "www.odopod.com", 14);
  //uint8_t len = NDEF().encode_URI(0x3, payload);

  //memcpy(payload, "this is some text", 17);
  //uint8_t len = NDEF().encode_TEXT((uint8_t *)"en", payload);

  //static uint8_t bitmapdata[220] = {0x47, 0x49, 0x46, 0x38, 0x39, 0x61, 0x12, 0x00, 0x12, 0x00, 0xb3, 0x00, 0x00,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 0x00, 0x3b};
  //memcpy(payload, bitmapdata, 220);
  //uint8_t len = NDEF().encode_MIME((uint8_t *)"image/gif", payload, 220);

   String vcff= "BEGIN:VCARD\nVERSION:2.1\nN:Coleman;Don;;;\nFN:Don Coleman\nORG:Chariot Solutions;\nURL:http://chariotsolutions.com\nTEL;WORK:215-358-1780\nEMAIL;WORK:info@chariotsolutions.com\nEND:VCARD";

   memcpy(payload, "BEGIN:VCARD\nVERSION:2.1\nN:Coleman;Don;;;\nFN:Don Coleman\nORG:Chariot Solutions;\nURL:http://chariotsolutions.com\nTEL;WORK:215-358-1780\nEMAIL;WORK:info@chariotsolutions.com\nEND:VCARD", vcff.length());
  uint8_t len = NDEF().encode_MIME((uint8_t *)"text/vcard", payload,vcff.length());



  if ( ! mfrc522.PICC_IsNewCardPresent())
    return;

  // Select one of the cards
  if ( ! mfrc522.PICC_ReadCardSerial())
    return;

  boolean success = writePayload(payload, len);
  Serial.println(success ? "success" : "fail");
  delay(5000);
}

boolean writePayload (uint8_t *payload, uint8_t length)
{
  return ultralight_writePayload(payload, length);
}

boolean ultralight_writePayload (uint8_t *payload, uint8_t len)
{
  const uint8_t zero[4] = {0x00, 0x00, 0x00, 0x00};

  uint8_t block_buffer[4] = {};
  uint8_t start_block = 4;

  uint8_t position = 0;
  uint8_t block_count = start_block;
  uint8_t byte_count = 0;

  while (position < len) {
    memcpy (block_buffer + byte_count, payload + position, 1);

    byte_count ++;
    position ++;
    if (byte_count == 4 ) {
      //end of block
      byte_count = 0;

      // write block
      //if (!ultralight_writeMemoryBlock(block_count, block_buffer))//#####################################33
      //return false;
      mfrc522.MIFARE_Ultralight_Write(block_count, block_buffer, 4);

      //reset
      memcpy(block_buffer, zero, 16);
      block_count ++;
    }

  }
  //write any remaining buffer
  if (byte_count > 0) {
    //if (!ultralight_writeMemoryBlock(block_count, block_buffer))//#############################################3
    //return false;
    mfrc522.MIFARE_Ultralight_Write(block_count, block_buffer, 4);
  }

  return true;
}
